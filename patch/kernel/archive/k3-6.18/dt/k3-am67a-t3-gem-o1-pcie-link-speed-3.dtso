// SPDX-License-Identifier: GPL-2.0
/*
 * DT Overlay to raise the PCIe0 Root Complex maximum link speed to Gen3.
 *
 * The base board description defaults PCIe0 to Gen2 (5.0 GT/s) because the
 * onboard M.2 slot (DX-M1) does not enumerate at Gen3 on current hardware.
 * This overlay sets `max-link-speed` to 3 (8.0 GT/s) for M.2 cards that do
 * train reliably at Gen3 and want the extra bandwidth. Apply it at runtime
 * via name_overlays in /boot/uEnv.txt.
 *
 * Copyright (C) 2026 T3 Foundation - https://www.t3vakfi.org/
 */

/dts-v1/;
/plugin/;

#include <dt-bindings/gpio/gpio.h>

/*
 * Helper to show loaded overlays under: /proc/device-tree/chosen/overlays/
 */
&{/chosen} {
	overlays {
		k3-am67a-t3-gem-o1-pcie-link-speed-3.kernel = __TIMESTAMP__;
	};
};

&pcie0_rc {
	max-link-speed = <3>;
};
